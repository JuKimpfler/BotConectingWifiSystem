// ============================================================
//  Teensy_lib/src/BotConnect.cpp
//  BL-compatible library for Teensy 4.0
// ============================================================

#include "BotConnect.h"
#include <string.h>
#include <stdio.h>
#include <stdlib.h>

BotConnect BC;
BotConnect_i2C BC_I2C;
static const uint32_t CTRL_ACTIVE_TIMEOUT_MS = 500;
static const uint8_t I2C_READ_CHUNK_SIZE = 32;
static const uint32_t I2C_REQUEST_INTERVAL_MS = 2;

void BotConnect::begin(HardwareSerial &serial, uint8_t satId) {
    _serial = &serial;
    _satId  = satId;
    _rxIdx  = 0;
    _p2pHead = 0;
    _p2pCount = 0;
    _lastCtrlMs  = 0;
    _ctrlReceived = false;
}

// ─── Main loop ───────────────────────────────────────────────
void BotConnect::process() {
    if (!_serial) return;

    while (_serial->available()) {
        char c = (char)_serial->read();
        if (c == '\n' || c == '\r') {
            if (_rxIdx > 0) {
                _rxBuf[_rxIdx] = '\0';
                _parseLine(_rxBuf);
                _rxIdx = 0;
            }
        } else {
            // Add character only if there's space, discard line on overflow
            if (_rxIdx < (int)(sizeof(_rxBuf) - 1)) {
                _rxBuf[_rxIdx++] = c;
            } else {
                // Buffer overflow - discard the entire line
                _rxIdx = 0;
            }
        }
    }

    // Update controlActive: true while a ctrl command was received within 500 ms
    if (_ctrlReceived && (millis() - _lastCtrlMs < CTRL_ACTIVE_TIMEOUT_MS)) {
        controlActive = true;
    } else {
        controlActive = false;
    }
}

// ─── Line parser ─────────────────────────────────────────────
// Commands from ESP satellite follow the patterns generated by
// CommandParser::_buildXxxCmd() in ESP_Satellite firmware.
//
// Examples:
//   V200A-45SW3BTN0START1    -> control
//   M3                        -> mode
//   CAL_IR_MAX                -> calibrate
//   HELLO_FROM_PEER           -> P2P message (anything else)
void BotConnect::_parseLine(const char *line) {
    if (!line || line[0] == '\0') return;

    // Control command: starts with 'V'
    // Format: V<speed>A<angle>SW<sw>BTN<btn>START<start>
    if (line[0] == 'V') {
        int sp = 0, ang = 0, sw = 0, btn = 0, st = 0;
        int parsed = sscanf(line, "V%dA%dSW%dBTN%dSTART%d",
                            &sp, &ang, &sw, &btn, &st);
        if (parsed == 5) {
            speed    = (int16_t)sp;
            angle    = (int16_t)ang;
            switches = (uint8_t)sw;
            buttons  = (uint8_t)btn;
            start    = (uint8_t)st;
            _lastCtrlMs  = millis();
            _ctrlReceived = true;
        }
        return;
    }

    // Mode command: M<n>  (modes 1–5)
    if (line[0] == 'M' && line[1] >= '1' && line[1] <= '5') {
        uint8_t modeId = (uint8_t)(line[1] - '0');
        mode1 = (modeId == 1);
        mode2 = (modeId == 2);
        mode3 = (modeId == 3);
        mode4 = (modeId == 4);
        mode5 = (modeId == 5);
        return;
    }

    // Calibrate: CAL_*
    if (strncmp(line, "CAL_", 4) == 0) {
        calIrMax   = (strcmp(line, CMD_CAL_IR_MAX)   == 0);
        calIrMin   = (strcmp(line, CMD_CAL_IR_MIN)   == 0);
        calLineMax = (strcmp(line, CMD_CAL_LINE_MAX)  == 0);
        calLineMin = (strcmp(line, CMD_CAL_LINE_MIN)  == 0);
        calBno     = (strcmp(line, CMD_CAL_BNO)       == 0);
        return;
    }

    // ACK responses: ACK<seq>:<status>
    // These are internal acknowledgements, typically not used by user code
    if (strncmp(line, "ACK", 3) == 0) {
        return;
    }

    // Everything else is treated as a P2P message from the peer robot
    _enqueueP2P(line);
    if (_onP2P) _onP2P(line);
}

// ─── Telemetry send helpers ───────────────────────────────────
// Wire format expected by CommandParser::uartLineToFrame():
//   DBG:name=value\n   (unified prefix as of protocol v1)
// The satellite firmware automatically tags telemetry with the correct SAT ID

void BotConnect::sendTelemetryInt(const char *name, int32_t value) {
    if (!_serial) return;
    char buf[64];
    snprintf(buf, sizeof(buf), "DBG:%s=%ld\n", name, (long)value);
    _sendLine(buf);
}

void BotConnect::sendTelemetryFloat(const char *name, float value) {
    if (!_serial) return;
    char buf[64];
    snprintf(buf, sizeof(buf), "DBG:%s=%.4f\n", name, value);
    _sendLine(buf);
}

void BotConnect::sendTelemetryBool(const char *name, bool value) {
    if (!_serial) return;
    char buf[64];
    snprintf(buf, sizeof(buf), "DBG:%s=%d\n", name, value ? 1 : 0);
    _sendLine(buf);
}

void BotConnect::sendTelemetryString(const char *name, const char *value) {
    if (!_serial) return;
    char buf[64];
    snprintf(buf, sizeof(buf), "DBG:%s=%s\n", name, value);
    _sendLine(buf);
}

void BotConnect::LedUpdate() {
    sendTelemetryBool("Led1", led1);
    sendTelemetryBool("Led2", led2);
    sendTelemetryBool("Led3", led3);
    sendTelemetryBool("Led4", led4);
}

void BotConnect::sendAck(uint8_t seq, uint8_t status) {
    if (!_serial) return;
    char buf[32];
    snprintf(buf, sizeof(buf), "ACK%u:%u\n", seq, status);
    _sendLine(buf);
}

// ─── P2P communication ────────────────────────────────────────
// Send a message to the peer robot via the P2P bridge.
// The message is sent without the "DBG:" prefix, so it will be
// transparently forwarded by the ESP satellite to the peer satellite,
// which will then output it to the peer Teensy's UART.
bool BotConnect::sendP2P(const char *message) {
    if (!_serial || !message) return false;
    // Send message directly (no DBG: prefix), ensure newline terminator
    size_t len = strlen(message);
    if (len > 0 && message[len - 1] == '\n') {
        _sendLine(message);
    } else {
        char buf[P2P_MAX_MSG_LEN];
        snprintf(buf, sizeof(buf), "%s\n", message);
        _sendLine(buf);
    }
    return true;
}

bool BotConnect::sendP2P(const String &message) {
    return sendP2P(message.c_str());
}

bool BotConnect::sendP2P(const uint8_t *data, size_t len) {
    if (!_serial || !data || len == 0) return false;
    // Copy into bounded buffer to guarantee newline termination
    uint8_t buf[P2P_MAX_MSG_LEN];
    size_t copyLen = (len < (P2P_MAX_MSG_LEN - 1)) ? len : (P2P_MAX_MSG_LEN - 1);
    memcpy(buf, data, copyLen);

    size_t outLen = copyLen;
    // Append newline if caller did not include one (and space available)
    if (copyLen == 0 || buf[copyLen - 1] != '\n') {
        buf[outLen++] = '\n';
    }

    _serial->write(buf, outLen);
    return true;
}

bool BotConnect::readP2P(char *out, size_t maxLen) {
    if (!out || maxLen == 0 || _p2pCount == 0) return false;
    const char *src = _p2pQueue[_p2pHead];
    strncpy(out, src, maxLen - 1);
    out[maxLen - 1] = '\0';
    _p2pHead = (uint8_t)((_p2pHead + 1) % P2P_QUEUE_SIZE);
    _p2pCount--;
    return true;
}

bool BotConnect::readP2P(String &out) {
    if (_p2pCount == 0) return false;
    out = _p2pQueue[_p2pHead];
    _p2pHead = (uint8_t)((_p2pHead + 1) % P2P_QUEUE_SIZE);
    _p2pCount--;
    return true;
}

void BotConnect::_sendLine(const char *line) {
    if (_serial) _serial->print(line);
}

void BotConnect::_enqueueP2P(const char *line) {
    if (!line || line[0] == '\0') return;

    uint8_t insertIdx = (uint8_t)((_p2pHead + _p2pCount) % P2P_QUEUE_SIZE);
    // If the queue is full, drop the oldest entry
    if (_p2pCount == P2P_QUEUE_SIZE) {
        _p2pHead = (uint8_t)((_p2pHead + 1) % P2P_QUEUE_SIZE);
        _p2pCount--;
    }

    strncpy(_p2pQueue[insertIdx], line, P2P_MAX_MSG_LEN - 1);
    _p2pQueue[insertIdx][P2P_MAX_MSG_LEN - 1] = '\0';
    _p2pCount++;
}

void BotConnect_i2C::begin(TwoWire &wire, uint8_t address) {
    _wire = &wire;
    _address = address;
    _ctrlReceived = false;
    _lastCtrlMs = 0;
}

void BotConnect_i2C::process() {
    if (!_wire) return;
    static uint32_t s_lastI2cPollMs = 0;
    uint32_t now = millis();
    if ((uint32_t)(now - s_lastI2cPollMs) < I2C_REQUEST_INTERVAL_MS) return;
    s_lastI2cPollMs = now;

    _wire->requestFrom(_address, I2C_READ_CHUNK_SIZE);
    int idx = 0;
    while (_wire->available() && idx < (int)(sizeof(_rxBuf) - 1)) {
        char c = (char)_wire->read();
        if (c == '\n' || c == '\r') {
            break;
        }
        _rxBuf[idx++] = c;
    }
    if (idx > 0) {
        _rxBuf[idx] = '\0';
        if (strcmp(_rxBuf, "NODATA") == 0) return;
        _parseLine(_rxBuf);
    }
    if (_ctrlReceived && (millis() - _lastCtrlMs < CTRL_ACTIVE_TIMEOUT_MS)) {
        controlActive = true;
    } else {
        controlActive = false;
    }
}

void BotConnect_i2C::sendTelemetryInt(const char *name, int32_t value) {
    if (!_wire) return;
    char buf[64];
    snprintf(buf, sizeof(buf), "DBG:%s=%ld\n", name, (long)value);
    _sendLine(buf);
}

void BotConnect_i2C::sendTelemetryFloat(const char *name, float value) {
    if (!_wire) return;
    char buf[64];
    snprintf(buf, sizeof(buf), "DBG:%s=%.4f\n", name, value);
    _sendLine(buf);
}

void BotConnect_i2C::sendTelemetryBool(const char *name, bool value) {
    if (!_wire) return;
    char buf[64];
    snprintf(buf, sizeof(buf), "DBG:%s=%d\n", name, value ? 1 : 0);
    _sendLine(buf);
}

void BotConnect_i2C::sendTelemetryString(const char *name, const char *value) {
    if (!_wire) return;
    char buf[64];
    snprintf(buf, sizeof(buf), "DBG:%s=%s\n", name, value);
    _sendLine(buf);
}

void BotConnect_i2C::LedUpdate() {
    sendTelemetryBool("Led1", led1);
    sendTelemetryBool("Led2", led2);
    sendTelemetryBool("Led3", led3);
    sendTelemetryBool("Led4", led4);
}

void BotConnect_i2C::_parseLine(const char *line) {
    if (!line || line[0] == '\0') return;
    if (line[0] == 'V') {
        int sp = 0, ang = 0, sw = 0, btn = 0, st = 0;
        int parsed = sscanf(line, "V%dA%dSW%dBTN%dSTART%d", &sp, &ang, &sw, &btn, &st);
        if (parsed == 5) {
            speed = (int16_t)sp;
            angle = (int16_t)ang;
            switches = (uint8_t)sw;
            buttons = (uint8_t)btn;
            start = (uint8_t)st;
            _lastCtrlMs = millis();
            _ctrlReceived = true;
        }
        return;
    }
    if (line[0] == 'M' && line[1] >= '1' && line[1] <= '5') {
        uint8_t modeId = (uint8_t)(line[1] - '0');
        mode1 = (modeId == 1);
        mode2 = (modeId == 2);
        mode3 = (modeId == 3);
        mode4 = (modeId == 4);
        mode5 = (modeId == 5);
        return;
    }
    if (strncmp(line, "CAL_", 4) == 0) {
        calIrMax   = (strcmp(line, CMD_CAL_IR_MAX)   == 0);
        calIrMin   = (strcmp(line, CMD_CAL_IR_MIN)   == 0);
        calLineMax = (strcmp(line, CMD_CAL_LINE_MAX) == 0);
        calLineMin = (strcmp(line, CMD_CAL_LINE_MIN) == 0);
        calBno     = (strcmp(line, CMD_CAL_BNO)      == 0);
        return;
    }
}

void BotConnect_i2C::_sendLine(const char *line) {
    if (!_wire || !line) return;
    _wire->beginTransmission(_address);
    _wire->write((const uint8_t *)line, strlen(line));
    _wire->endTransmission();
}
